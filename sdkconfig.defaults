## sdkconfig.defaults
```kconfig
# Common SDK config defaults
CONFIG_ESPTOOLPY_FLASHSIZE_16MB=y
CONFIG_PARTITION_TABLE_CUSTOM=y
CONFIG_PARTITION_TABLE_CUSTOM_FILENAME="partitions.csv"

# PSRAM
CONFIG_SPIRAM=y
CONFIG_SPIRAM_MODE_OCT=y
CONFIG_SPIRAM_SPEED_80M=y

# LVGL
CONFIG_LV_USE_PERF_MONITOR=n
CONFIG_LV_COLOR_DEPTH_16=y
CONFIG_LV_DPI_DEF=130
CONFIG_LV_FONT_MONTSERRAT_14=y
CONFIG_LV_FONT_MONTSERRAT_16=y
CONFIG_LV_FONT_MONTSERRAT_20=y
CONFIG_LV_FONT_MONTSERRAT_24=y
CONFIG_LV_FONT_MONTSERRAT_28=y
CONFIG_LV_FONT_MONTSERRAT_32=y

# FreeRTOS
CONFIG_FREERTOS_HZ=1000
CONFIG_FREERTOS_TIMER_TASK_STACK_DEPTH=4096

# HTTP Client
CONFIG_ESP_HTTP_CLIENT_ENABLE_HTTPS=y

# NVS
CONFIG_NVS_ENCRYPTION=n

# Camera
CONFIG_MIPI_CSI_ISR_IRAM_SAFE=y

# Task Watchdog
CONFIG_ESP_TASK_WDT_TIMEOUT_S=30
```
